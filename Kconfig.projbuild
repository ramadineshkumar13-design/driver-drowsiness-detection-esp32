## Kconfig.projbuild
```kconfig
menu "Driver Drowsiness System Configuration"

    config ENABLE_SIMULATION_MODE
        bool "Enable Sensor Simulation Mode (No Hardware Required)"
        default y
        help
            When enabled, sensor_task injects synthetic breathing waveforms and steering
            activity instead of reading the physical ADS1115 I2C ADC. Ideal for testing.

    config SIMULATION_SCENARIO_DURATION_SEC
        int "Simulation Scenario Cycle Duration in Seconds"
        default 60
        depends on ENABLE_SIMULATION_MODE
        help
            Total period of the simulated state sequence (Normal -> Road Bumps -> Apnea -> Recovery).

    menu "Hardware Pin Configuration"

        config I2C_MASTER_SDA_GPIO
            int "I2C SDA GPIO Pin"
            default 21

        config I2C_MASTER_SCL_GPIO
            int "I2C SCL GPIO Pin"
            default 22

        config MOTOR_PWM_GPIO
            int "L298N Motor ENA (PWM) GPIO Pin"
            default 18

        config MOTOR_IN1_GPIO
            int "L298N Motor IN1 GPIO Pin"
            default 19

        config MOTOR_IN2_GPIO
            int "L298N Motor IN2 GPIO Pin"
            default 5

        config BUZZER_GPIO
            int "Buzzer Control GPIO Pin"
            default 23

        config LED_WARNING_GPIO
            int "Warning LED GPIO Pin"
            default 2

        config LED_CRITICAL_GPIO
            int "Critical/Emergency LED GPIO Pin"
            default 4

        config GPS_UART_NUM
            int "GPS NEO-6M UART Port Number (0, 1, or 2)"
            default 2

        config GPS_UART_RX_GPIO
            int "GPS UART RX Pin"
            default 16

        config GPS_UART_TX_GPIO
            int "GPS UART TX Pin"
            default 17

        config GSM_UART_NUM
            int "GSM SIM800L UART Port Number (0, 1, or 2)"
            default 1

        config GSM_UART_RX_GPIO
            int "GSM UART RX Pin"
            default 27

        config GSM_UART_TX_GPIO
            int "GSM UART TX Pin"
            default 26

    endmenu

    menu "Safety Thresholds & Timings"

        config BREATHING_NORMAL_MIN_BPM
            int "Minimum Normal Breathing Rate (BPM)"
            default 10

        config BREATHING_NORMAL_MAX_BPM
            int "Maximum Normal Breathing Rate (BPM)"
            default 30

        config APNEA_DETECTION_TIMEOUT_SEC
            int "Apnea / Breath Cessation Detection Timeout (Seconds)"
            default 8

        config STEERING_INACTIVE_TIMEOUT_SEC
            int "Steering Inactivity Timeout (Seconds)"
            default 7

        config WARNING_TO_CRITICAL_TIMEOUT_SEC
            int "Warning State Escalation Timeout to Critical (Seconds)"
            default 5

        config MOTOR_RAMP_DOWN_TIME_SEC
            int "Motor PWM Deceleration Ramp Duration (Seconds)"
            default 4

    endmenu

endmenu
```

## sdkconfig.defaults
```kconfig
# Application configuration defaults
CONFIG_IDF_TARGET="esp32"
CONFIG_ESP_DEFAULT_CPU_FREQ_MHZ_240=y
CONFIG_ESP_DEFAULT_CPU_FREQ_MHZ=240

# FreeRTOS configuration
CONFIG_FREERTOS_HZ=1000
CONFIG_FREERTOS_CHECK_STACKOVERFLOW_CANARY=y
CONFIG_FREERTOS_USE_TRACE_FACILITY=y
CONFIG_FREERTOS_USE_STATS_FORMATTING_FUNCTIONS=y

# Task Watchdog Timer (TWDT)
CONFIG_ESP_TASK_WDT_EN=y
CONFIG_ESP_TASK_WDT_INIT=y
CONFIG_ESP_TASK_WDT_TIMEOUT_S=5
CONFIG_ESP_TASK_WDT_CHECK_IDLE_TASK_CPU0=y
CONFIG_ESP_TASK_WDT_CHECK_IDLE_TASK_CPU1=y

# Log output
CONFIG_LOG_DEFAULT_LEVEL_INFO=y
CONFIG_LOG_COLORS=y
```
